
    op_STOP equ 0
    op_EXIT equ 1
    op_CALL equ 2
    op_JMP equ 3
    op_JMPZ equ 4
    op_JMPNZ equ 5
    op_STORE equ 6
    op_CSTORE equ 7
    op_FETCH equ 8
    op_CFETCH equ 9
    op_LIT1 equ 10
    op_LIT4 equ 11
    op_DUP equ 12
    op_SWAP equ 13
    op_OVER equ 14
    op_DROP equ 15
    op_ADD equ 16
    op_MUL equ 17
    op_SLASHMOD equ 18
    op_SUB equ 19
    op_LT equ 20
    op_EQ equ 21
    op_GT equ 22
    op_NOT equ 23
    op_DO equ 24
    op_LOOP equ 25
    op_LOOP2 equ 26
    op_INDEX equ 27
    op_DTOR equ 28
    op_RFETCH equ 29
    op_RTOD equ 30
    op_INC equ 31
    op_INCADDR equ 32
    op_DEC equ 33
    op_DECADDR equ 34
    op_COM equ 35
    op_AND equ 36
    op_OR equ 37
    op_XOR equ 38
    op_EMIT equ 39
    op_TIMER equ 40
    op_SYSTEM equ 41
    op_KEY equ 42
    op_QKEY equ 43
    op_ISNUM equ 44
    op_DEFINE equ 45
    op_ENDWORD equ 46
    op_CREATE equ 47
    op_FIND equ 48
    op_WORD equ 49
    op_FOPEN equ 50
    op_LOAD equ 51
    op_FCLOSE equ 52
    op_FREAD equ 53
    op_FWRITE equ 54
    op_REG_I equ 55
    op_REG_D equ 56
    op_REG_R equ 57
    op_REG_S equ 58
    op_REG_NEW equ 59
    op_REG_FREE equ 60
    op_FREE1 equ 61
    op_FREE2 equ 62
    op_FREE3 equ 63
